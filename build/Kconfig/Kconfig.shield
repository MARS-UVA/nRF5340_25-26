## build/Kconfig/arch/Kconfig
```kconfig
# Load Zephyr Arch Kconfig descriptions.
osource "/home/diana/ncs/v3.1.0/zephyr/arch/rx/Kconfig"
osource "/home/diana/ncs/v3.1.0/zephyr/arch/x86/Kconfig"
osource "/home/diana/ncs/v3.1.0/zephyr/arch/xtensa/Kconfig"
osource "/home/diana/ncs/v3.1.0/zephyr/arch/sparc/Kconfig"
osource "/home/diana/ncs/v3.1.0/zephyr/arch/riscv/Kconfig"
osource "/home/diana/ncs/v3.1.0/zephyr/arch/posix/Kconfig"
osource "/home/diana/ncs/v3.1.0/zephyr/arch/mips/Kconfig"
osource "/home/diana/ncs/v3.1.0/zephyr/arch/arm64/Kconfig"
osource "/home/diana/ncs/v3.1.0/zephyr/arch/arm/Kconfig"
osource "/home/diana/ncs/v3.1.0/zephyr/arch/arc/Kconfig"
```

## build/Kconfig/boards/Kconfig.defconfig
```kconfig
# Load Zephyr board defconfig descriptions.
osource "/home/diana/ncs/v3.1.0/zephyr/boards/nordic/nrf5340dk/Kconfig.defconfig"
```

## build/test-app-2/Kconfig/boards/Kconfig
```kconfig
# Load Zephyr board Kconfig descriptions.
osource "/home/diana/ncs/v3.1.0/zephyr/boards/nordic/nrf5340dk/Kconfig"
```
